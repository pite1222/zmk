/*
 * Copyright (c) 2026 The Conductor Contributors
 *
 * SPDX-License-Identifier: MIT
 */

/ {
    behaviors {
        // Behavior can be invoked on peripherals, so name must be <= 8 characters.
        scrl_inv: scroll_invert_toggle {
            compatible = "zmk,behavior-scroll-invert-toggle";
            #binding-cells = <0>;
            display-name = "Toggle Scroll Invert";
        };
    };
};
