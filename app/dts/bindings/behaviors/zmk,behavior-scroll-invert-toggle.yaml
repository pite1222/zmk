## app/dts/bindings/behaviors/zmk,behavior-scroll-invert-toggle.yaml
```yaml
# Copyright (c) 2026 The Conductor Contributors
# SPDX-License-Identifier: MIT

description: Scroll invert toggle behavior

compatible: "zmk,behavior-scroll-invert-toggle"

include: zero_param.yaml
```

## app/dts/bindings/input/zmk,input-processor-studio-pointer-scaler.yaml
```yaml
# Copyright (c) 2025 The Conductor Contributors
# SPDX-License-Identifier: MIT

description: |
  Dynamic pointer scaler input processor for ZMK Studio precision mode.
  Reads scaling parameters from runtime variables set by the
  pointing subsystem RPC handler, enabling real-time precision-mode
  sensitivity adjustment from Conductor Studio.

compatible: "zmk,input-processor-studio-pointer-scaler"

include: base.yaml

properties:
  "#input-processor-cells":
    type: int
    required: true
    const: 0
  type:
    type: int
    default: 0x02  # INPUT_EV_REL
  codes:
    type: array
    required: true
  track-remainders:
    type: boolean

input-processor-cells:
  []
```

## app/dts/bindings/input/zmk,input-processor-studio-scaler.yaml
```yaml
# Copyright (c) 2025 The Conductor Contributors
# SPDX-License-Identifier: MIT

description: |
  Dynamic scaler input processor for ZMK Studio.
  Reads scaling parameters from runtime variables set by the
  pointing subsystem RPC handler, enabling real-time scroll
  sensitivity adjustment from Conductor Studio.

compatible: "zmk,input-processor-studio-scaler"

include: base.yaml

properties:
  "#input-processor-cells":
    type: int
    required: true
    const: 0
  type:
    type: int
    default: 0x02  # INPUT_EV_REL
  codes:
    type: array
    required: true
  track-remainders:
    type: boolean

input-processor-cells:
  []
```

## app/src/pointing/Kconfig
```kconfig
# Copyright (c) 2024 The ZMK Contributors
# SPDX-License-Identifier: MIT

menu "Pointing Options"

# Deprecated old config, kept for backwards compat
config ZMK_MOUSE
    bool "(Deprecated) Mouse Support"

config ZMK_POINTING
    bool "Pointing Device Support"
    default y if ZMK_MOUSE
    select INPUT
    select INPUT_THREAD_PRIORITY_OVERRIDE

if ZMK_POINTING

# Needed for anyone using gpio-keys for things like soft-off setup.
config INPUT_GPIO_KEYS
    default n

config INPUT_THREAD_STACK_SIZE
    default 1024 if ZMK_SPLIT && !ZMK_SPLIT_ROLE_CENTRAL

if !ZMK_SPLIT || ZMK_SPLIT_ROLE_CENTRAL

config ZMK_POINTING_SMOOTH_SCROLLING
    bool "Smooth Scrolling"
    help
      Enable smooth scrolling, with hosts that support HID Resolution Multipliers

config ZMK_INPUT_LISTENER
    bool "Input listener for processing input events in the system"
    default y
    depends on DT_HAS_ZMK_INPUT_LISTENER_ENABLED


config ZMK_INPUT_PROCESSOR_TEMP_LAYER
    bool "Temporary Layer Input Processor"
    default y
    depends on DT_HAS_ZMK_INPUT_PROCESSOR_TEMP_LAYER_ENABLED

config ZMK_INPUT_PROCESSOR_TEMP_LAYER_MAX_ACTION_EVENTS
    int "Temporary Layer Input Processor Max Action Events"
    default 4
    depends on ZMK_INPUT_PROCESSOR_TEMP_LAYER

endif

config ZMK_POINTING_BLE_KEEPALIVE
    bool "BLE Pointing Keepalive"
    depends on ZMK_BLE
    help
      Send periodic zero-motion HID reports while the pointing device is idle
      to prevent the host OS from widening the BLE connection interval.
      This eliminates the lag on the first trackball movement after a few
      seconds of inactivity (most noticeable on macOS).

config ZMK_POINTING_BLE_KEEPALIVE_INTERVAL_MS
    int "Keepalive interval (ms)"
    default 2000
    depends on ZMK_POINTING_BLE_KEEPALIVE
    help
      How often to send a zero-motion report while idle.

config ZMK_POINTING_BLE_KEEPALIVE_MAX_IDLE_MS
    int "Max idle time before stopping keepalive (ms)"
    default 60000
    depends on ZMK_POINTING_BLE_KEEPALIVE
    help
      Stop sending keepalive reports after this much idle time to save battery.

config ZMK_INPUT_PROCESSOR_TRANSFORM
    bool "Transform Input Processor"
    default y
    depends on DT_HAS_ZMK_INPUT_PROCESSOR_TRANSFORM_ENABLED

config ZMK_INPUT_PROCESSOR_SCALER
    bool "Scaling Input Processor"
    default y
    depends on DT_HAS_ZMK_INPUT_PROCESSOR_SCALER_ENABLED

config ZMK_INPUT_PROCESSOR_STUDIO_SCALER
    bool "Studio Dynamic Scaler Input Processor"
    default y
    depends on DT_HAS_ZMK_INPUT_PROCESSOR_STUDIO_SCALER_ENABLED

config ZMK_INPUT_PROCESSOR_CODE_MAPPER
    bool "Code Mapper Input Processor"
    default y
    depends on DT_HAS_ZMK_INPUT_PROCESSOR_CODE_MAPPER_ENABLED

config ZMK_INPUT_PROCESSOR_BEHAVIORS
    bool "Behaviors Input Processor"
    default y
    depends on DT_HAS_ZMK_INPUT_PROCESSOR_BEHAVIORS_ENABLED

config ZMK_INPUT_SPLIT
    bool "Split input support"
    default y
    depends on DT_HAS_ZMK_INPUT_SPLIT_ENABLED && ZMK_SPLIT

if ZMK_INPUT_SPLIT

config ZMK_INPUT_SPLIT_INIT_PRIORITY
    int "Input Split initialization priority"
    default INPUT_INIT_PRIORITY


config ZMK_INPUT_SPLIT_MAX_TRACKED_KEYS
    int "Input Split max tracked keys to release on peripheral disconnect"
    default 5

endif # ZMK_INPUT_SPLIT

endif # ZMK_POINTING

endmenu # Mouse Options
```

## app/west.yml
```yaml
manifest:
  remotes:
    - name: zephyrproject-rtos
      url-base: https://github.com/zephyrproject-rtos
    - name: zmkfirmware
      url-base: https://github.com/zmkfirmware
    - name: pite1222
      url-base: https://github.com/pite1222
  projects:
    - name: zephyr
      remote: zmkfirmware
      revision: v3.5.0+zmk-fixes
      clone-depth: 1
      import:
        name-blocklist:
          - ci-tools
          - hal_altera
          - hal_cypress
          - hal_infineon
          - hal_microchip
          - hal_nxp
          - hal_openisa
          - hal_silabs
          - hal_xtensa
          - hal_st
          - hal_ti
          - loramac-node
          - mcuboot
          - mcumgr
          - net-tools
          - openthread
          - edtt
          - trusted-firmware-m
    - name: nanopb
      revision: 8c60555d6277a0360c876bd85d491fc4fb0cd74a
      path: modules/lib/nanopb
      remote: zmkfirmware
    - name: zmk-studio-messages
      revision: 69224f6
      path: modules/msgs/zmk-studio-messages
      remote: pite1222
  self:
    west-commands: scripts/west-commands.yml
```
